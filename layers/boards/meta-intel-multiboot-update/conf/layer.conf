## layers/boards/meta-intel-multiboot-update/conf/machine/intel-skylake-64-multiboot.conf
```bitbake
#@TYPE: Machine
#@NAME: intel-skylake-64-multiboot

#@DESCRIPTION: Machine configuration for 64 bit Intel Skylake CPU (and later) with MMX, SSE, SSE2, SSE3, SSE4.1, SSE4.2, AVX, and AVX2 instruction set support. Supports a moderately wide range of drivers that should boot and be usable on "typical" hardware.

# -----------------------------------------------
# Customization of the intel-skylake-64 machine configuration
# -----------------------------------------------

require conf/machine/intel-skylake-64.conf
MACHINEOVERRIDES =. "intel-skylake-64:"

# -----------------------------------------------
# Machine specific configuration
# -----------------------------------------------

DISTRO_FEATURES:append = " systemd"
VIRTUAL-RUNTIME_init_manager = "systemd"
DISTRO_FEATURES_BACKFILL_CONSIDERED = "sysvinit"
VIRTUAL-RUNTIME_initscripts = ""

# Memory and partition table properties
STORAGE_TYPE = "sda"
PTABLE_TYPE = "gpt"

# Bootloader settings
PREFERRED_PROVIDER_virtual/bootloader = "grub"
PREFERRED_RPROVIDER_virtual-grub-bootconf = "rauc-n100-grubconf"

IMAGE_BOOT_FILES = "bzImage efi-boot.vfat grub.cfg grubenv"

# -----------------------------------------------
# Multiboot partition scheme variable definitions
# -----------------------------------------------

WIC_DEVICE="sda"

# Bootloader
WIC_BOOTLOADER_PART_SIZE = "64M"
WIC_BOOTLOADER_PART_CMD = "\
    /boot   --source rawcopy --sourceparams='file=efi-boot.vfat' \
--fstype=vfat --label boot --active --align 4096 --fixed-size ${WIC_BOOTLOADER_PART_SIZE}\
"
WIC_BOOTLOADER_EXTRA_ENV_PART_SIZE = "64M"
WIC_BOOTLOADER_EXTRA_PART_CMD = "part --align 4096 --ondisk sda --no-table --fixed-size ${WIC_BOOTLOADER_EXTRA_ENV_PART_SIZE}"
WIC_BOOTLOADER_ENV_PART_SIZE = "4M"
WIC_BOOTLOADER_ENV_PART_CMD = "\
part --source rawcopy --sourceparams='file=grubenv.vfat' \
--fstype=vfat --label grubenv --align 1024 --fixed-size ${WIC_BOOTLOADER_ENV_PART_SIZE}\
"
WIC_BOOTLOADER_CONFIG = "--ptable ${PTABLE_TYPE}"

# Software partitions
WIC_FIRST_PARTITION_OFFSET = "" 
WIC_KERNELIMG_PART_SIZE = "128M"
WIC_KERNELIMG_SOURCE = "--source bootimg-partition"
WIC_RECOVERY_ROOTFS_PART_SIZE = "768M"
WIC_RECOVERY_ROOTFS_SOURCE = "--source rootfs --rootfs-dir ${RECOVERY_IMAGE_NAME}"
WIC_SYSTEM_ROOTFS_PART_SIZE = "1536M"
WIC_SYSTEM_ROOTFS_SOURCE = "--source rootfs --rootfs-dir ${SYSTEM_IMAGE_NAME}"
WIC_APPFS_MIN_PART_SIZE = "128M"
```

## layers/boards/meta-qemu-multiboot-update/conf/machine/qemux86-64-multiboot.conf
```bitbake
# -----------------------------------------------
# Customization of the qemux86-64 machine configuration
# -----------------------------------------------

require conf/machine/qemux86-64.conf
MACHINEOVERRIDES =. "qemux86-64:"

# -----------------------------------------------
# Machine specific configuration
# -----------------------------------------------

# System capabilities
MACHINE_FEATURES:append = " pcbios efi"
EXTRA_IMAGEDEPENDS += "ovmf"

DISTRO_FEATURES:append = " systemd"
VIRTUAL-RUNTIME_init_manager = "systemd"
DISTRO_FEATURES_BACKFILL_CONSIDERED = "sysvinit"
VIRTUAL-RUNTIME_initscripts = ""

# Memory and partition table properties
STORAGE_TYPE = "sda"
PTABLE_TYPE = "gpt"

# Bootloader settings
PREFERRED_PROVIDER_virtual/bootloader = "grub"
PREFERRED_RPROVIDER_virtual-grub-bootconf = "rauc-grubconf"

ENABLE_DUAL_BOOTLOADER = "yes"

# Kernel features
KERNEL_EXTRA_FEATURES += "features/overlayfs/overlayfs.scc"

# Image features
IMAGE_INSTALL:append = " \
    kernel-image \
    kernel-modules \
"

# -----------------------------------------------
# Multiboot partition scheme variable definitions
# -----------------------------------------------

WIC_DEVICE="sda"

# Bootloader
WIC_BOOTLOADER_PART_SIZE = "40M"
WIC_BOOTLOADER_PART_CMD = "\
    /boot   --source rawcopy --sourceparams='file=efi-boot.vfat' \
            --fstype=vfat --label boot --active --align 4096 --fixed-size ${WIC_BOOTLOADER_PART_SIZE} \
"
# Extra partition for bootloader updates
WIC_BOOTLOADER_EXTRA_PART_CMD = "\
    part --ondisk ${WIC_DEVICE} --fixed-size ${WIC_BOOTLOADER_PART_SIZE} --align 4096 --no-table \
"
WIC_BOOTLOADER_ENV_PART_CMD = "\
    part --ondisk ${WIC_DEVICE} --source rawcopy --sourceparams='file=grubenv.vfat' \
        --fstype=vfat --label grubenv --fixed-size 10M --align 1024 \
"
WIC_BOOTLOADER_CONFIG = "--ptable ${PTABLE_TYPE}"

# Unfortunately, we can't use the automatic image-based lookup provided by wic if we specify an exclude-path -
# therefore, we need to manually specify expected paths (which are stable though).
SYSTEM_IMAGE_ROOTFS_PATH = "${BASE_WORKDIR}/${MULTIMACH_TARGET_SYS}/${SYSTEM_IMAGE_NAME}/1.0/rootfs"
RECOVERY_IMAGE_ROOTFS_PATH = "${BASE_WORKDIR}/${MULTIMACH_TARGET_SYS}/${RECOVERY_IMAGE_NAME}/1.0/rootfs"

# Software partitions
WIC_FIRST_PARTITION_OFFSET = "" 
WIC_KERNELIMG_PART_SIZE = "50M"
# The kernel image will be deployed in the rootfs
WIC_KERNELIMG_SOURCE = "--source rootfs --rootfs-dir ${SYSTEM_IMAGE_ROOTFS_PATH}/boot"
WIC_RECOVERY_ROOTFS_PART_SIZE = "150M"
WIC_RECOVERY_ROOTFS_SOURCE = "--source rootfs --rootfs-dir ${RECOVERY_IMAGE_ROOTFS_PATH} --exclude-path boot/"
WIC_SYSTEM_ROOTFS_PART_SIZE = "400M"
WIC_SYSTEM_ROOTFS_SOURCE = "--source rootfs --rootfs-dir ${SYSTEM_IMAGE_ROOTFS_PATH} --exclude-path boot/"
WIC_APPFS_MIN_PART_SIZE = "100M"
```

## layers/boards/meta-raspberrypi-multiboot-update/conf/machine/raspberrypi3-multiboot.conf
```bitbake
# -----------------------------------------------
# Customization of the raspberrypi3 machine configuration
# -----------------------------------------------

require conf/machine/raspberrypi3.conf
MACHINEOVERRIDES =. "raspberrypi3:"

# -----------------------------------------------
# Machine specific configuration
# -----------------------------------------------

require raspberrypi-common.inc

# Device tree configuration
DTB_FILE_NAME = "bcm2710-rpi-3-b-plus.dtb"

# -----------------------------------------------
# Multiboot partition scheme variable definitions
# -----------------------------------------------

WIC_DEVICE="${MMC_BLOCK_DEVICE}"

# Bootloader
WIC_BOOTLOADER_PART_SIZE = "25M"
WIC_BOOTLOADER_PART_CMD = "\
    /boot   --source extract-from-archive --sourceparams='file=rpi-bootloader-files.tar.gz' \
            --fstype=vfat --label boot --active --align 4096 --fixed-size ${WIC_BOOTLOADER_PART_SIZE}\
"
WIC_BOOTLOADER_EXTRA_PART_CMD = ""
WIC_BOOTLOADER_ENV_PART_CMD = ""
WIC_BOOTLOADER_CONFIG = "--ptable ${PTABLE_TYPE}"

# Software partitions
WIC_FIRST_PARTITION_OFFSET = "" 
WIC_KERNELIMG_PART_SIZE = "50M"
WIC_KERNELIMG_SOURCE = "--source bootimg-partition"
WIC_RECOVERY_ROOTFS_PART_SIZE = "150M"
WIC_RECOVERY_ROOTFS_SOURCE = "--source rootfs --rootfs-dir ${RECOVERY_IMAGE_NAME}"
WIC_SYSTEM_ROOTFS_PART_SIZE = "400M"
WIC_SYSTEM_ROOTFS_SOURCE = "--source rootfs --rootfs-dir ${SYSTEM_IMAGE_NAME}"
WIC_APPFS_MIN_PART_SIZE = "100M"
```
